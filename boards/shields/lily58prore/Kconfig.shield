## boards/shields/lily58prore/Kconfig.shield
```kconfig
# Copyright (c) 2020 Pete Johanson
# SPDX-License-Identifier: MIT

config SHIELD_lily58prore_LEFT
    def_bool $(shields_list_contains,lily58prore_left)

config SHIELD_lily58prore_RIGHT
    def_bool $(shields_list_contains,lily58prore_right)
```
